/*
 * gpu-enable.dts — Device-tree overlay for Pi 5 D0 stepping GPU
 *
 * The D0-stepping DTB (bcm2712d0-rpi-5-b.dtb) sets the GPU node's
 * compatible to "brcm,bcm2712d0-vc6" only, but the vc4-drm kernel
 * driver matches on "brcm,bcm2712-vc6".  This overlay adds the
 * fallback compatible string and enables the node so the full
 * display pipeline (vc4 + HDMI) binds at boot.
 */
/dts-v1/;
/plugin/;

/ {
	compatible = "brcm,bcm2712";

	fragment@0 {
		target-path = "/axi/gpu";
		__overlay__ {
			compatible = "brcm,bcm2712d0-vc6", "brcm,bcm2712-vc6";
			status = "okay";
		};
	};
};
