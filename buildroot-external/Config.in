## buildroot-external/Config.in
```kconfig
menu "clock8002 external packages"
	source "$BR2_EXTERNAL_CLOCK8002_PATH/package/python-smbus2/Config.in"
	source "$BR2_EXTERNAL_CLOCK8002_PATH/package/python-luma-core/Config.in"
	source "$BR2_EXTERNAL_CLOCK8002_PATH/package/python-luma-oled/Config.in"
	source "$BR2_EXTERNAL_CLOCK8002_PATH/package/libltc/Config.in"
	source "$BR2_EXTERNAL_CLOCK8002_PATH/package/clock8002/Config.in"
endmenu
```

## buildroot-external/package/clock8002/Config.in
```kconfig
config BR2_PACKAGE_CLOCK8002
	bool "clock8002"
	select BR2_PACKAGE_SDL3
	select BR2_PACKAGE_SDL3_TTF
	select BR2_PACKAGE_SDL3_IMAGE
	select BR2_PACKAGE_LIBLTC
	help
	  clock8002 appliance package placeholder.
	  This prototype installs runtime files and service units into the image.

	  The deployed sdl-clock name is kept only for compatibility with the
	  .244-style boot/runtime scripts. The binary itself is built from
	  cmd/sdl3-clock; SDL2 is not part of this Buildroot image path.

if BR2_PACKAGE_CLOCK8002

config BR2_PACKAGE_CLOCK8002_SOURCE_DIR
	string "clock8002 source directory"
	default "$(TOPDIR)/../clock8002-root-ram/v4"
	help
	  Local source tree path used by the package (site method local).

endif
```

## buildroot-external/package/libltc/Config.in
```kconfig
config BR2_PACKAGE_LIBLTC
	bool "libltc"
	depends on BR2_USE_MMU
	help
	  libltc is a portable C library for encoding and decoding of
	  Linear (or Longitudinal) Timecode (LTC), compliant with
	  SMPTE 12M and EBU R68.

	  Used by alsa-ltc to read LTC from an audio input.

	  https://github.com/x42/libltc
```

## buildroot-external/package/python-luma-core/Config.in
```kconfig
config BR2_PACKAGE_PYTHON_LUMA_CORE
	bool "python-luma-core"
	select BR2_PACKAGE_PYTHON_CBOR2
	select BR2_PACKAGE_PYTHON_PILLOW
	select BR2_PACKAGE_PYTHON_SMBUS2
	help
	  A small library to drive a series of display devices with Python
	  code, with support for PIL/Pillow 2D drawing primitives.

	  https://github.com/rm-hull/luma.core
```

## buildroot-external/package/python-luma-oled/Config.in
```kconfig
config BR2_PACKAGE_PYTHON_LUMA_OLED
	bool "python-luma-oled"
	select BR2_PACKAGE_PYTHON_LUMA_CORE
	help
	  Python library to drive monochrome OLED displays with Pillow.

	  https://github.com/rm-hull/luma.oled
```

## buildroot-external/package/python-smbus2/Config.in
```kconfig
config BR2_PACKAGE_PYTHON_SMBUS2
	bool "python-smbus2"
	help
	  Pure Python SMBus and I2C module.

	  https://github.com/kplindegaard/smbus2
```

## buildroot-external/package/rpi-eeprom/Config.in
```kconfig
config BR2_PACKAGE_RPI_EEPROM
	bool "rpi-eeprom"
	depends on BR2_PACKAGE_PYTHON3
	depends on BR2_aarch64
	help
	  Raspberry Pi EEPROM bootloader configuration and update tools.

	  Installs rpi-eeprom-config, rpi-eeprom-update, rpi-eeprom-digest,
	  and the Pi 5 (BCM2712) firmware blobs needed for EEPROM updates.

	  rpi-eeprom-config reads the current bootloader configuration via
	  the kernel nvmem device (no vcgencmd required on Pi 5).

	  https://github.com/raspberrypi/rpi-eeprom
```

## buildroot-external/package/sdl3-image/Config.in
```kconfig
config BR2_PACKAGE_SDL3_IMAGE
	bool "sdl3-image"
	depends on BR2_TOOLCHAIN_HAS_THREADS
	depends on BR2_USE_MMU
	select BR2_PACKAGE_SDL3
	select BR2_PACKAGE_LIBPNG
	select BR2_PACKAGE_JPEG
	help
	  SDL3_image is an image file loading library for SDL3,
	  supporting PNG, JPEG, and other formats.

	  Required at runtime by sdl3-clock via purego dlopen for
	  background image loading.

	  https://github.com/libsdl-org/SDL_image
```

## buildroot-external/package/sdl3-ttf/Config.in
```kconfig
config BR2_PACKAGE_SDL3_TTF
	bool "sdl3-ttf"
	depends on BR2_TOOLCHAIN_HAS_THREADS
	depends on BR2_USE_MMU
	select BR2_PACKAGE_SDL3
	select BR2_PACKAGE_FREETYPE
	select BR2_PACKAGE_HARFBUZZ
	help
	  SDL3_ttf is a TrueType font rendering library for SDL3.

	  Required at runtime by sdl3-clock via purego dlopen.

	  https://github.com/libsdl-org/SDL_ttf
```

## buildroot-external/package/sdl3/Config.in
```kconfig
config BR2_PACKAGE_SDL3
	bool "sdl3"
	depends on BR2_TOOLCHAIN_HAS_THREADS
	depends on BR2_USE_MMU
	select BR2_PACKAGE_LIBDRM
	help
	  SDL3 is a cross-platform development library for low-level
	  access to audio, keyboard, mouse, joystick, and graphics
	  hardware.

	  This build enables the KMSDRM video backend required for
	  headless Raspberry Pi operation (no X11/Wayland).

	  Required at runtime by sdl3-clock via purego dlopen.

	  https://www.libsdl.org/
```
